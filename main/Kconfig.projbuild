## main/Kconfig.projbuild
```kconfig
menu "ESP Radar Configuration"

    menu "Wi-Fi"
        config ESP_RADAR_WIFI_SSID
            string "Wi-Fi SSID"
            default "myssid"
            help
                SSID (network name) of the access point to connect to.

        config ESP_RADAR_WIFI_PASSWORD
            string "Wi-Fi password"
            default "mypassword"
            help
                WPA/WPA2 password of the access point. Leave empty for an open network.

        config ESP_RADAR_WIFI_MAX_RETRY
            int "Maximum connection retries"
            default 10
            help
                How many times to retry connecting before reporting failure.
    endmenu

    menu "Location"
        config ESP_RADAR_ZIP_CODE
            string "ZIP / postal code (display label only)"
            default "10001"
            help
                Shown on the radar header. The actual query uses the latitude and
                longitude below.

        config ESP_RADAR_HOME_LAT
            string "Home latitude (decimal degrees)"
            default "40.7128"
            help
                Latitude of the radar centre, e.g. "40.7128". North is positive.

        config ESP_RADAR_HOME_LON
            string "Home longitude (decimal degrees)"
            default "-74.0060"
            help
                Longitude of the radar centre, e.g. "-74.0060". East is positive.
    endmenu

    menu "Radar"
        config ESP_RADAR_RANGE_NM
            int "Radar range / query radius (nautical miles)"
            range 5 250
            default 50
            help
                Radius of the outer range ring and the adsb.lol query. adsb.lol
                accepts up to 250 NM.

        config ESP_RADAR_REFRESH_SEC
            int "Refresh interval (seconds)"
            range 5 600
            default 15
            help
                How often to poll adsb.lol for new aircraft positions.

        config ESP_RADAR_BEEP
            bool "Beep on each successful update"
            default y
            help
                Play a short tone through the on-board PCM5101 DAC after each
                successful refresh.
    endmenu

    menu "Display"
        config ESP_RADAR_UI_CLOCK
            bool "Show background analog clock"
            default y
            help
                Draw the dim amber analog clock (hands + hour pips) behind the scope.

        config ESP_RADAR_UI_RINGS
            bool "Show range rings"
            default y
            help
                Draw the concentric range rings.

        config ESP_RADAR_UI_BATTERY
            bool "Show battery indicator"
            default y
            help
                Show the battery indicator when a battery is detected.

        config ESP_RADAR_UI_HEADER
            bool "Show header line"
            default y
            help
                Show the top header (location label / range / aircraft count).

        config ESP_RADAR_UI_STATUS
            bool "Show status line"
            default y
            help
                Show the bottom status line (WIFI... / LINK UP / API ERR / ...).

        config ESP_RADAR_UI_LABELS
            bool "Show aircraft data blocks"
            default y
            help
                Draw the 4-line data block (callsign / type / FL / speed) next to
                each aircraft.

        config ESP_RADAR_UI_LEADERS
            bool "Show aircraft leader lines"
            default y
            help
                Draw the velocity leader line pointing along each aircraft's track.
    endmenu

    menu "Clock"
        config ESP_RADAR_TZ
            string "POSIX timezone string"
            default "EST5EDT,M3.2.0,M11.1.0"
            help
                POSIX TZ string used for the background clock. Examples:
                US Eastern "EST5EDT,M3.2.0,M11.1.0",
                US Pacific "PST8PDT,M3.2.0,M11.1.0",
                UK "GMT0BST,M3.5.0/1,M10.5.0",
                UTC "UTC0".

        config ESP_RADAR_NTP_SERVER
            string "NTP server"
            default "pool.ntp.org"
            help
                Hostname of the SNTP server used to pull the current time.
    endmenu

endmenu
```
